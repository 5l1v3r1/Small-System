
#include <string.h>
#include <stdio.h>

#include "delay.h"
#include "key_api.h"
#include "lcd_api.h"

#include "graphics_api.h"
#include "graphics_bitmap.h"
#include "graphics_font.h"
#include "graphics_window.h"
#include "graphics_window_widget.h"
#include "graphics_widget.h"
#include "graphics_background.h"

static const char messagebox_warning_flag[]={0x42,0x4D,0xFF,0x00,0x00,0x00,0x00,0x00,0x00,0x00,0x36,0x00,0x00,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0x00,0x00};
    
typedef unsigned int window_point;

window_list_  window_list;
window_handle window_front=INVALID_WINDOW_HANDLE;

static bool graphics_window_list_add(const unsigned int list_index,window_handle new_handle,window_name new_name,window_title new_title,window_background_color new_background_color,window_height new_height,window_width new_width,bool is_show_title,window_notice_recall new_recall_event) {
    widget_handle clear_widget_handle_index=0;
    if (list_index<MAX_WINDOW_AND_MESSAGE_COUNT && window_list.current_window_data[list_index].handle==INVALID_WINDOW_HANDLE) {
        window_list.current_window_data[list_index].background_color=new_background_color;
        window_list.current_window_data[list_index].x=0;
        window_list.current_window_data[list_index].y=0;
        window_list.current_window_data[list_index].handle=new_handle;
        window_list.current_window_data[list_index].height=new_height;
        window_list.current_window_data[list_index].width=new_width;
        window_list.current_window_data[list_index].show_stat=false;
        window_list.current_window_data[list_index].show_title=is_show_title;
        window_list.current_window_data[list_index].recall_event=new_recall_event;
        window_list.current_window_data[list_index].widget_count=0;
        memset(window_list.current_window_data[list_index].widget_list,0,MAX_WIDGET_COUNT*sizeof(window_widget));
        for (;clear_widget_handle_index<MAX_WIDGET_COUNT;++clear_widget_handle_index)
            window_list.current_window_data[list_index].widget_list[clear_widget_handle_index].widget_handle=INVALID_WIDGET_HANDLE;
        memcpy((void*)window_list.current_window_data[list_index].title,new_title,WINDOW_TITLE_LENGTH);
        memcpy((void*)window_list.current_window_data[list_index].name,new_name,WINDOW_NAME_LENGTH);
        return true;
    }
    return false;
}

static void graphics_window_list_clean(const unsigned int list_index) {
    widget_handle clear_widget_handle_index=0;
    if (list_index<MAX_WINDOW_AND_MESSAGE_COUNT)    {
        window_list.current_window_data[list_index].background_color=WINDOW_DEFUALT_BACKGROUND_COLOR;
        window_list.current_window_data[list_index].handle=INVALID_WINDOW_HANDLE;
        window_list.current_window_data[list_index].x=0;
        window_list.current_window_data[list_index].y=0;
        window_list.current_window_data[list_index].height=0;
        window_list.current_window_data[list_index].width=0;
        memset((void*)window_list.current_window_data[list_index].title,0,WINDOW_TITLE_LENGTH);
        memset((void*)window_list.current_window_data[list_index].name,0,WINDOW_NAME_LENGTH);
        window_list.current_window_data[list_index].recall_event=NULL;
        window_list.current_window_data[list_index].show_stat=false;
        window_list.current_window_data[list_index].show_title=false;
        window_list.current_window_data[list_index].widget_count=0;
        memset(window_list.current_window_data[list_index].widget_list,0,MAX_WIDGET_COUNT*sizeof(window_widget));
        for (;clear_widget_handle_index<MAX_WIDGET_COUNT;++clear_widget_handle_index)
            window_list.current_window_data[list_index].widget_list[clear_widget_handle_index].widget_handle=INVALID_WIDGET_HANDLE;
    }
}

void graphics_window_init(void) {
    unsigned int clean_window_index=0;
    
    window_list.current_window_count=0;
    for (;clean_window_index<MAX_WINDOW_AND_MESSAGE_COUNT;++clean_window_index)
        graphics_window_list_clean(clean_window_index);
}

/*
         ___________________________
        |Title  [Blue Color]     - x|
        |---------------------------|
        |                           |
        |    [BackGround Color]     |
        |                           |
        |___________________________|

    //  TIPS!  这是全屏显示的..

*/

#define FILL_COLOR_TITLE                   blue
#define DISTANCE_TITLE_TO_TOP                 1
#define DISTANCE_TITLE_TO_LEFT                1
#define DISTANCE_TITLE_TO_RIGHT               1
#define DISTANCE_TITLE_FILL                  20
#define DISTANCE_TITLE_STRING_TO_TOP          2
#define DISTANCE_TITLE_STRING_TO_LEFT         3
#define FILL_COLOR_TITLE_CLOSE_BUTTOM       red
#define DISTANCE_TITLE_CLOSE_BUTTOM_HEIGHT   16
#define DISTANCE_TITLE_CLOSE_BUTTOM_WIDTH    16
#define DISTANCE_TITLE_CLOSE_BUTTOM_TO_TOP    2
#define DISTANCE_TITLE_CLOSE_BUTTOM_TO_RIGHT  3
#define DISTANCE_TITLE_BETWEEN_BUTTON         2
#define FILL_COLOR_TITLE_MIN_BUTTOM       green
#define DISTANCE_TITLE_MIN_BUTTOM_HEIGHT     16
#define DISTANCE_TITLE_MIN_BUTTOM_WIDTH      16
#define DISTANCE_TITLE_MIN_BUTTOM_TO_TOP      2
#define DISTANCE_TITLE_MIN_BUTTOM_TO_RIGHT   (DISTANCE_TITLE_BETWEEN_BUTTON+DISTANCE_TITLE_CLOSE_BUTTOM_WIDTH+DISTANCE_TITLE_CLOSE_BUTTOM_TO_RIGHT)

window_handle create_window(window_name name,window_title title,bool is_show_title,window_notice_recall notice_event) {
    window_handle find_empty_list=INVALID_WINDOW_HANDLE;
    if (window_list.current_window_count<MAX_WINDOW_COUNT) {
        for (find_empty_list=0;find_empty_list<MAX_WINDOW_COUNT;++find_empty_list) {
            if (INVALID_WINDOW_HANDLE==window_list.current_window_data[find_empty_list].handle) {
                graphics_window_list_add(find_empty_list,find_empty_list,name,title,WINDOW_DEFUALT_BACKGROUND_COLOR,SCREEN_LONGITUDINAL_PIXEL-DISTANCE_TITLE_FILL,SCREEN_HORIZONTAL_PIXEL-DISTANCE_TITLE_TO_RIGHT,is_show_title,notice_event);
                return find_empty_list;
            }
        }
    }
    return INVALID_WINDOW_HANDLE;
}

void refresh_window_title(window_handle handle) {
    if (INVALID_WINDOW_HANDLE!=handle) {
        if (INVALID_WINDOW_HANDLE!=window_list.current_window_data[handle].handle) {
            lcd_draw_rectangle(0,0,window_list.current_window_data[handle].width,DISTANCE_TITLE_FILL,window_list.current_window_data[handle].background_color,true);
            lcd_draw_rectangle(DISTANCE_TITLE_TO_LEFT,DISTANCE_TITLE_TO_TOP,window_list.current_window_data[handle].width-DISTANCE_TITLE_TO_RIGHT,DISTANCE_TITLE_FILL,FILL_COLOR_TITLE,true);
            graphics_draw_font_string(window_list.current_window_data[handle].title,DISTANCE_TITLE_STRING_TO_LEFT,DISTANCE_TITLE_STRING_TO_TOP,white);
            lcd_draw_rectangle(window_list.current_window_data[handle].width-DISTANCE_TITLE_CLOSE_BUTTOM_WIDTH-DISTANCE_TITLE_CLOSE_BUTTOM_TO_RIGHT,DISTANCE_TITLE_CLOSE_BUTTOM_TO_TOP,window_list.current_window_data[handle].width-DISTANCE_TITLE_CLOSE_BUTTOM_TO_RIGHT,DISTANCE_TITLE_CLOSE_BUTTOM_TO_TOP+DISTANCE_TITLE_CLOSE_BUTTOM_HEIGHT,FILL_COLOR_TITLE_CLOSE_BUTTOM,true);
        }
    }
}

void refresh_window_background(window_handle handle) {
    if (INVALID_WINDOW_HANDLE!=handle) {
        if (INVALID_WINDOW_HANDLE!=window_list.current_window_data[handle].handle) {
            if (window_list.current_window_data[handle].show_title)
                lcd_draw_rectangle(0,DISTANCE_TITLE_FILL,window_list.current_window_data[handle].width,window_list.current_window_data[handle].height+DISTANCE_TITLE_FILL,window_list.current_window_data[handle].background_color,true);
            else 
                lcd_draw_rectangle(0,0,window_list.current_window_data[handle].width,window_list.current_window_data[handle].height+DISTANCE_TITLE_FILL,window_list.current_window_data[handle].background_color,true);
        }
    }
}

void refresh_window(window_handle handle) {
    widget_handle refresh_widget_index=0;
    if (INVALID_WINDOW_HANDLE!=handle) {
        if (window_list.current_window_data[handle].show_title)
            refresh_window_title(handle);
        refresh_window_background(handle);
        for (;refresh_widget_index<MAX_WIDGET_COUNT;++refresh_widget_index)
            draw_widget(handle,refresh_widget_index);
    }
}

window_handle get_window_front(void) {
    return window_front;
}

void set_window_front(window_handle in_window_handle) {
    if (INVALID_WINDOW_HANDLE!=in_window_handle) {
        //  TIPS:信息框不计在内
        refresh_window(in_window_handle);
        window_front=in_window_handle;
    }
}

bool show_window(window_handle handle) {
    if (INVALID_WINDOW_HANDLE!=handle) {
        if (INVALID_WINDOW_HANDLE!=window_list.current_window_data[handle].handle && !window_list.current_window_data[handle].show_stat) {
            if (0==window_list.current_window_data[handle].x && 0==window_list.current_window_data[handle].y) {
                set_window_front(handle);
            } else {
                lcd_draw_rectangle(window_list.current_window_data[handle].x,window_list.current_window_data[handle].y,window_list.current_window_data[handle].x+window_list.current_window_data[handle].width,window_list.current_window_data[handle].y+window_list.current_window_data[handle].height,window_list.current_window_data[handle].background_color,true);
                lcd_draw_rectangle(window_list.current_window_data[handle].x+DISTANCE_TITLE_TO_LEFT,window_list.current_window_data[handle].y+DISTANCE_TITLE_TO_TOP,window_list.current_window_data[handle].x+window_list.current_window_data[handle].width-DISTANCE_TITLE_TO_RIGHT,window_list.current_window_data[handle].y+DISTANCE_TITLE_FILL,FILL_COLOR_TITLE,true);
                lcd_draw_rectangle(window_list.current_window_data[handle].x+window_list.current_window_data[handle].width-DISTANCE_TITLE_CLOSE_BUTTOM_WIDTH-DISTANCE_TITLE_CLOSE_BUTTOM_TO_RIGHT,window_list.current_window_data[handle].y+DISTANCE_TITLE_CLOSE_BUTTOM_TO_TOP,window_list.current_window_data[handle].x+window_list.current_window_data[handle].width-DISTANCE_TITLE_CLOSE_BUTTOM_TO_RIGHT,window_list.current_window_data[handle].y+DISTANCE_TITLE_CLOSE_BUTTOM_TO_TOP+DISTANCE_TITLE_CLOSE_BUTTOM_HEIGHT,FILL_COLOR_TITLE_CLOSE_BUTTOM,true);
                graphics_draw_font_string(window_list.current_window_data[handle].title,window_list.current_window_data[handle].x+DISTANCE_TITLE_STRING_TO_LEFT,window_list.current_window_data[handle].y+DISTANCE_TITLE_STRING_TO_TOP,white);
            }
            window_list.current_window_data[handle].show_stat=true;
            return true;
        }
    }
    return false;
}

void set_window_show_title(window_handle handle,bool is_show) {
    if (INVALID_WINDOW_HANDLE!=handle && INVALID_WINDOW_HANDLE!=window_list.current_window_data[handle].handle) {
        window_list.current_window_data[handle].show_title=is_show;
        refresh_window(handle);
    }
}

void set_window_title(window_handle handle,const char* new_title) {
    if (INVALID_WINDOW_HANDLE!=handle && INVALID_WINDOW_HANDLE!=window_list.current_window_data[handle].handle) {
        if (strlen(new_title)<=WINDOW_TITLE_LENGTH) {
            memset((void*)window_list.current_window_data[handle].title,0,WINDOW_TITLE_LENGTH);
            memcpy((void*)window_list.current_window_data[handle].title,new_title,(strlen(new_title)<WINDOW_TITLE_LENGTH)?strlen(new_title):WINDOW_TITLE_LENGTH);
        }
        if (window_front==handle)
            refresh_window_title(handle);
    }
}

void set_window_background_color(window_handle handle,color new_color) {
    if (INVALID_WINDOW_HANDLE!=handle && INVALID_WINDOW_HANDLE!=window_list.current_window_data[handle].handle) {
        window_list.current_window_data[handle].background_color=new_color;
        refresh_window(handle);
    }
}

void close_window(window_handle handle) {
    window_handle check_live_window=0;
    
    if (INVALID_WINDOW_HANDLE!=handle) {
        if (INVALID_WINDOW_HANDLE!=window_list.current_window_data[handle].handle && window_list.current_window_data[handle].show_stat) {
            lcd_draw_rectangle(window_list.current_window_data[handle].x,window_list.current_window_data[handle].y,window_list.current_window_data[handle].x+window_list.current_window_data[handle].width,window_list.current_window_data[handle].y+window_list.current_window_data[handle].height+DISTANCE_TITLE_FILL,black,true); 
            graphics_window_list_clean(handle);
            graphics_draw_background();
            
            for (check_live_window=MAX_WINDOW_COUNT-1;check_live_window>0;--check_live_window) {
                if (INVALID_WINDOW_HANDLE!=window_list.current_window_data[check_live_window].handle) {
                    set_window_front(check_live_window);
                    return;
                }
            }
            if (INVALID_WINDOW_HANDLE!=window_list.current_window_data[0].handle) {
                set_window_front(window_list.current_window_data[0].handle);
                return;
            }
            window_front=INVALID_WINDOW_HANDLE;
        }
    }
}

void notice_window(window_handle handle,notice_flag in_notice_flag,long parameter1,long parameter2) {
    widget_handle find_click_widget=0;
    button_click_recall click_recall_address=NULL;
    
    if (NULL==window_list.current_window_data[handle].recall_event) return;
    
    switch (in_notice_flag) {
        case notice_click:
            if ((window_list.current_window_data[handle].x+window_list.current_window_data[handle].width-DISTANCE_TITLE_CLOSE_BUTTOM_TO_RIGHT-DISTANCE_TITLE_CLOSE_BUTTOM_WIDTH<=parameter1 && 
                 parameter1<=window_list.current_window_data[handle].x+window_list.current_window_data[handle].width-DISTANCE_TITLE_CLOSE_BUTTOM_TO_RIGHT)&& 
                (window_list.current_window_data[handle].y+DISTANCE_TITLE_CLOSE_BUTTOM_TO_TOP<=parameter2 &&
                 parameter2<=window_list.current_window_data[handle].y+DISTANCE_TITLE_CLOSE_BUTTOM_TO_TOP+DISTANCE_TITLE_CLOSE_BUTTOM_HEIGHT)) {
                     window_list.current_window_data[handle].recall_event(handle,notice_close,0,0);
                     close_window(handle);
                     return;
                 }
            if ((window_list.current_window_data[handle].x+DISTANCE_TITLE_TO_LEFT<=parameter1 && parameter1<=window_list.current_window_data[handle].x+window_list.current_window_data[handle].width-DISTANCE_TITLE_TO_RIGHT)&& 
                (window_list.current_window_data[handle].y+DISTANCE_TITLE_FILL<=parameter2 && parameter2<=window_list.current_window_data[handle].y+DISTANCE_TITLE_FILL+window_list.current_window_data[handle].height)) {
                for (;find_click_widget<MAX_WIDGET_COUNT;++find_click_widget) {
                    switch (window_list.current_window_data[handle].widget_list[find_click_widget].widget_type) {
                        case widget_button:
                            if ((window_list.current_window_data[handle].x+window_list.current_window_data[handle].widget_list[find_click_widget].x+DISTANCE_TITLE_TO_LEFT<=parameter1 &&
                                 parameter1<=window_list.current_window_data[handle].x+window_list.current_window_data[handle].widget_list[find_click_widget].x+window_list.current_window_data[handle].widget_list[find_click_widget].widget_width+DISTANCE_TITLE_TO_LEFT) &&
                                (window_list.current_window_data[handle].y+window_list.current_window_data[handle].widget_list[find_click_widget].y+DISTANCE_TITLE_FILL<=parameter2 &&
                                 parameter2<=window_list.current_window_data[handle].y+window_list.current_window_data[handle].widget_list[find_click_widget].y+window_list.current_window_data[handle].widget_list[find_click_widget].widget_height+DISTANCE_TITLE_FILL)) {
                                     memcpy(&click_recall_address,window_list.current_window_data[handle].widget_list[find_click_widget].widget_data,sizeof(button_click_recall));
                                     if (NULL!=click_recall_address) {
                                         click_recall_address();
                                         return;
                                     }
                                 }
                            break;
                        case widget_picture:
                            if ((window_list.current_window_data[handle].x+window_list.current_window_data[handle].widget_list[find_click_widget].x+DISTANCE_TITLE_TO_LEFT<=parameter1 &&
                                 parameter1<=window_list.current_window_data[handle].x+window_list.current_window_data[handle].widget_list[find_click_widget].x+window_list.current_window_data[handle].widget_list[find_click_widget].widget_width+DISTANCE_TITLE_TO_LEFT) &&
                                (window_list.current_window_data[handle].y+window_list.current_window_data[handle].widget_list[find_click_widget].y+DISTANCE_TITLE_FILL<=parameter2 &&
                                 parameter2<=window_list.current_window_data[handle].y+window_list.current_window_data[handle].widget_list[find_click_widget].y+window_list.current_window_data[handle].widget_list[find_click_widget].widget_height+DISTANCE_TITLE_FILL)) {
                                     memcpy(&click_recall_address,(const void*)((unsigned long)window_list.current_window_data[handle].widget_list[find_click_widget].widget_data+12),sizeof(button_click_recall));
                                     if (NULL!=click_recall_address) {
                                         click_recall_address();
                                         return;
                                     }
                                 }
                            break;
                        default:
                            break;
                    }
                }
                window_list.current_window_data[handle].recall_event(handle,notice_click,parameter1,parameter2);
            }
            break;
        case notice_close:
            window_list.current_window_data[handle].recall_event(handle,notice_close,0,0);
            close_window(handle);
            break;
    }
}

/*
                               DEFAULT WIDTH=200
                         |                           |
                         |---------------------------|
                         |                           |
                    ___   ___________________________    ___
DEFAULT CAPTION Y    |   |Box_Title [Blue Color]  - x|    |
                    _|_  |---------------------------|    |    DEFAULT HEIGHT=120
                         |         CAPTION           |    |
                         |___________________________|   _|_

                         |                           |
                         |---------|
                         DEFAULT CAPTION X

style messagebox_tips:
         ___________________________ 
        |Box_Title [Blue Color]  - x|
        |---------------------------|
        |                           |
        |         CAPTION           |
        |         ________          |
        |        |___OK___|         |
        |___________________________|

style messagebox_question:
         ___________________________ 
        |Box_Title [Blue Color]  - x|
        |---------------------------|
        |                           |
        |         CAPTION           |
        |   ________     ________   |
        |  |___OK___|   |_Cancel_|  |
        |___________________________|

style messagebox_warning:
         ___________________________ 
        |Box_Title [Blue Color]  - x|
        |---------------------------|
        |  -----                    |
        | |  !  |      CAPTION      |
        |  -----  ________          |
        |        |___OK___|         |
        |___________________________|

*/

#define MAX_LENGTH_BOX_TITLE     16
#define MAX_LENGTH_BOX_CAPTION   32

#define DEFAULT_BOX_WIDTH       200
#define DEFAULT_BOX_HEIGHT      120
#define DEFAULT_BUTTON_WIDTH     60
#define DEFAULT_BUTTON_HEIGHT    20
#define DEFAULT_PICTURE_WIDTH    40
#define DEFAULT_PICTURE_HEIGHT   40

#define DISTANCE_BUTTON_TO_LABEL   5
#define DISTANCE_BUTTON_BETWEEN   20
#define DISTANCE_PICTURE_TO_TOP    8
#define DISTANCE_PICTURE_TO_LEFT  10
#define DISTANCE_PICTURE_TO_LABEL 16

messagebox_return click_code=no_click;

static void messagebox_ok_click_event(void) {
    click_code=click_ok;
}

static void messagebox_cancel_click_event(void) {
    click_code=click_cancel;
}

static void messagebox_notice_event(window_handle recall_window,notice_flag in_notice_flag,long parameter1,long parameter2) {
    switch (in_notice_flag) {
        case notice_click:
            break;
        case notice_close:
            click_code=click_exit;
            break;
    }
}

messagebox_return messagebox(window_height call_messagebox_window,const char* box_caption,const char* box_title,messagebox_style show_style) {
//  WARNING! 由于内存太小,所以label 用不了,改用直接将graphics_draw_font_string 把文字打印到窗口中 ..
    window_height messagebox_height=DEFAULT_BOX_HEIGHT;
    window_width  messagebox_width=DEFAULT_BOX_WIDTH;
    graphics_location messgaebox_x=0;
    graphics_location messgaebox_y=0;
    window_handle find_empty_window=0;
//    window_widget label;
//    widget_handle label_handle=INVALID_WIDGET_HANDLE;
    window_widget button_ok;
    widget_handle button_ok_handle=INVALID_WIDGET_HANDLE;
    window_widget button_cancel;
    widget_handle button_cancel_handle=INVALID_WIDGET_HANDLE;
    window_widget picture_warning;
    widget_handle picture_warning_handle=INVALID_WIDGET_HANDLE;
    char output_box_title[MAX_LENGTH_BOX_TITLE]={0};
    char output_box_caption[MAX_LENGTH_BOX_CAPTION]={0};
    char output_line[MAX_LENGTH_BOX_CAPTION/2+1]={0};

    click_code=no_click;
    
    if (NULL!=box_title) {
        if (strlen(box_title)<=MAX_LENGTH_BOX_TITLE)
            memcpy(output_box_title,box_title,strlen(box_title));
        else
            memcpy(output_box_title,box_title,MAX_LENGTH_BOX_TITLE);
    }
    if (NULL!=box_caption) {
        if (strlen(box_caption)<=MAX_LENGTH_BOX_CAPTION)
            memcpy(output_box_caption,box_caption,strlen(box_caption));
        else
            memcpy(output_box_caption,box_caption,MAX_LENGTH_BOX_CAPTION);
    }
    
    lcd_calcu_middle_location(0,0,SCREEN_HORIZONTAL_PIXEL,SCREEN_LONGITUDINAL_PIXEL,&messgaebox_x,&messgaebox_y);
    messgaebox_x-=DEFAULT_BOX_WIDTH/2;
    messgaebox_y-=DEFAULT_BOX_HEIGHT/2;
/*    
    label.widget_width=FONT_WIDTH*(MAX_LENGTH_BOX_CAPTION/2);
    label.widget_height=FONT_HEIGHT*2;
    label.x=messagebox_width/2-label.widget_width/2;
    label.y=messagebox_height/2-label.widget_height;
    label.widget_type=widget_label;
*/
    find_empty_window=create_window("messagebox",output_box_title,false,&messagebox_notice_event);
    window_list.current_window_data[find_empty_window].x=messgaebox_x;
    window_list.current_window_data[find_empty_window].y=messgaebox_y;
    window_list.current_window_data[find_empty_window].width=DEFAULT_BOX_WIDTH;
    window_list.current_window_data[find_empty_window].height=DEFAULT_BOX_HEIGHT;
    show_window(find_empty_window);
    
    if (show_style!=messagebox_warning) {
        if (strlen(output_box_caption)<(MAX_LENGTH_BOX_CAPTION/2)) {
            graphics_draw_font_string(output_box_caption,messgaebox_x+messagebox_width/2-(FONT_WIDTH*strlen(output_box_caption)/2),messgaebox_y+messagebox_height/2-FONT_HEIGHT,black);
        } else {
            memcpy(output_line,output_box_caption,MAX_LENGTH_BOX_CAPTION/2);
            graphics_draw_font_string(output_line,messgaebox_x+messagebox_width/2-(FONT_WIDTH*16)/2,messgaebox_y+messagebox_height/2-FONT_HEIGHT*2,black);
            memcpy(output_line,(const void*)((unsigned long)output_box_caption+MAX_LENGTH_BOX_CAPTION/2),MAX_LENGTH_BOX_CAPTION/2);
            graphics_draw_font_string(output_line,messgaebox_x+messagebox_width/2-(FONT_WIDTH*16)/2,messgaebox_y+messagebox_height/2-FONT_HEIGHT,black);
        }
    } else {
        if (strlen(output_box_caption)<(MAX_LENGTH_BOX_CAPTION/2)) {
            graphics_draw_font_string(output_box_caption,messgaebox_x+DISTANCE_PICTURE_TO_LEFT+DEFAULT_PICTURE_WIDTH+DISTANCE_PICTURE_TO_LABEL,messgaebox_y+messagebox_height/2-FONT_HEIGHT,black);
        } else {
            memcpy(output_line,output_box_caption,MAX_LENGTH_BOX_CAPTION/2);
            graphics_draw_font_string(output_line,messgaebox_x+DISTANCE_PICTURE_TO_LEFT+DEFAULT_PICTURE_WIDTH+DISTANCE_PICTURE_TO_LABEL,messgaebox_y+messagebox_height/2-FONT_HEIGHT*2,black);
            memcpy(output_line,(const void*)((unsigned long)output_box_caption+MAX_LENGTH_BOX_CAPTION/2),MAX_LENGTH_BOX_CAPTION/2);
            graphics_draw_font_string(output_line,messgaebox_x+DISTANCE_PICTURE_TO_LEFT+DEFAULT_PICTURE_WIDTH+DISTANCE_PICTURE_TO_LABEL,messgaebox_y+messagebox_height/2-FONT_HEIGHT,black);
        }
    }

    switch (show_style) {
        case messagebox_tips:
/*
            label_handle=create_widget(find_empty_window,&label);
            set_label_caption(find_empty_window,label_handle,output_box_caption);
            draw_widget(find_empty_window,label_handle);
*/
            button_ok.widget_width=DEFAULT_BUTTON_WIDTH;
            button_ok.widget_height=DEFAULT_BUTTON_HEIGHT;
            button_ok.x=messagebox_width/2-DEFAULT_BUTTON_WIDTH/2;
            button_ok.y=messagebox_height/2+DISTANCE_BUTTON_TO_LABEL;
            button_ok.widget_type=widget_button;
            button_ok_handle=create_widget(find_empty_window,&button_ok);
            set_button_click_recall(find_empty_window,button_ok_handle,&messagebox_ok_click_event);
            set_button_caption(find_empty_window,button_ok_handle,"OK");
            draw_widget(find_empty_window,button_ok_handle);
            break;
        case messagebox_question:
            button_ok.widget_width=DEFAULT_BUTTON_WIDTH;
            button_ok.widget_height=DEFAULT_BUTTON_HEIGHT;
            button_ok.x=messagebox_width/2-DISTANCE_BUTTON_BETWEEN/2-DEFAULT_BUTTON_WIDTH;
            button_ok.y=messagebox_height/2+DISTANCE_BUTTON_TO_LABEL;
            button_ok.widget_type=widget_button;
            button_ok_handle=create_widget(find_empty_window,&button_ok);
            set_button_click_recall(find_empty_window,button_ok_handle,&messagebox_ok_click_event);
            set_button_caption(find_empty_window,button_ok_handle,"OK");
            draw_widget(find_empty_window,button_ok_handle);
            button_cancel.widget_width=DEFAULT_BUTTON_WIDTH;
            button_cancel.widget_height=DEFAULT_BUTTON_HEIGHT;
            button_cancel.x=messagebox_width/2+DISTANCE_BUTTON_BETWEEN/2;
            button_cancel.y=messagebox_height/2+DISTANCE_BUTTON_TO_LABEL;
            button_cancel.widget_type=widget_button;
            button_cancel_handle=create_widget(find_empty_window,&button_cancel);
            set_button_click_recall(find_empty_window,button_cancel_handle,&messagebox_cancel_click_event);
            set_button_caption(find_empty_window,button_cancel_handle,"Cancel");
            draw_widget(find_empty_window,button_cancel_handle);
            break;
        case messagebox_warning:
            picture_warning.x=DISTANCE_PICTURE_TO_LEFT;
            picture_warning.y=DISTANCE_PICTURE_TO_TOP;
            picture_warning.widget_type=widget_picture;
            picture_warning_handle=create_widget(find_empty_window,&picture_warning);
            set_picture_bitmap(find_empty_window,picture_warning_handle,(bitmap_data)messagebox_warning_flag);
            draw_widget(find_empty_window,picture_warning_handle);
            button_ok.widget_width=DEFAULT_BUTTON_WIDTH;
            button_ok.widget_height=DEFAULT_BUTTON_HEIGHT;
            button_ok.x=messagebox_width/2-DISTANCE_BUTTON_BETWEEN/2-DEFAULT_BUTTON_WIDTH;
            button_ok.y=messagebox_height/2+DISTANCE_BUTTON_TO_LABEL;
            button_ok.widget_type=widget_button;
            button_ok_handle=create_widget(find_empty_window,&button_ok);
            set_button_click_recall(find_empty_window,button_ok_handle,&messagebox_ok_click_event);
            set_button_caption(find_empty_window,button_ok_handle,"OK");
            draw_widget(find_empty_window,button_ok_handle);
            button_cancel.widget_width=DEFAULT_BUTTON_WIDTH;
            button_cancel.widget_height=DEFAULT_BUTTON_HEIGHT;
            button_cancel.x=messagebox_width/2+DISTANCE_BUTTON_BETWEEN/2;
            button_cancel.y=messagebox_height/2+DISTANCE_BUTTON_TO_LABEL;
            button_cancel.widget_type=widget_button;
            button_cancel_handle=create_widget(find_empty_window,&button_cancel);
            set_button_click_recall(find_empty_window,button_cancel_handle,&messagebox_cancel_click_event);
            set_button_caption(find_empty_window,button_cancel_handle,"Cancel");
            draw_widget(find_empty_window,button_cancel_handle);
            break;
        default:
            break;
    }
    while (no_click==click_code) {
        if (lcd_is_touch()) {
            delay_ms(50);
            notice_window(find_empty_window,notice_click,lcd_touch_x(),lcd_touch_y());
        }
    }
    close_window(find_empty_window);
    refresh_window(call_messagebox_window);  //  TIPS! 到时候可以直接这样..window_front  
    return click_code;
}

void graphics_init(void) {
    graphics_background_init();
    graphics_window_init();
}

window_handle create_window_handle=INVALID_WINDOW_HANDLE;
widget_handle label_handle=INVALID_WIDGET_HANDLE;
widget_handle button_handle=INVALID_WIDGET_HANDLE;
widget_handle progress_handle=INVALID_WIDGET_HANDLE;
widget_handle picture_handle=INVALID_WIDGET_HANDLE;
window_widget label;
window_widget button;
window_widget progress;
window_widget picture;

unsigned long click_index=0;

void test_button_click_event(void) {
    set_label_caption(create_window_handle,label_handle,"button click!");
    ++click_index;
    set_progress_value(create_window_handle,progress_handle,click_index);
}

void test_picture_click_event(void) {
    set_label_caption(create_window_handle,label_handle,"picture click!");
}

void test_notics_window(window_handle recall_window,notice_flag in_notice_flag,long parameter1,long parameter2) {
    switch (in_notice_flag) {
        case notice_click:
            set_label_caption(recall_window,label_handle,"window click!");
            break;
        case notice_close:
            break;
    }
}

extern char kernel_logo[];

void window_test(void) {
    create_window_handle=create_window("test window","test window",true,&test_notics_window);
    if (INVALID_WINDOW_HANDLE!=create_window_handle) {
        show_window(create_window_handle);
        label.widget_type=widget_label;
        label.widget_height=100;
        label.widget_width=110;
        label.x=120;
        label.y=20;
        label_handle=create_widget(create_window_handle,&label);
        set_label_caption(create_window_handle,label_handle,"Hello world!");
        draw_widget(create_window_handle,label_handle);
            
        button.widget_type=widget_button;
        button.widget_height=100;
        button.widget_width=100;
        button.x=0;
        button.y=20;
        button_handle=create_widget(create_window_handle,&button);
        set_button_click_recall(create_window_handle,button_handle,&test_button_click_event);
        set_button_caption(create_window_handle,button_handle,"test click");
        draw_widget(create_window_handle,button_handle);
                
        progress.widget_type=widget_progress;
        progress.widget_height=10;
        progress.widget_width=100;
        progress.x=110;
        progress.y=70;
        progress_handle=create_widget(create_window_handle,&progress);
        set_progress_max_value(create_window_handle,progress_handle,10);
        set_progress_value(create_window_handle,progress_handle,0);
        draw_widget(create_window_handle,progress_handle);
        
        picture.widget_type=widget_picture;
        picture.x=100;
        picture.y=200;
        picture_handle=create_widget(create_window_handle,&picture);
        set_picture_click_recall(create_window_handle,picture_handle,&test_picture_click_event);
        set_picture_bitmap(create_window_handle,picture_handle,kernel_logo);
        draw_widget(create_window_handle,picture_handle);
        
        if (click_ok==messagebox(create_window_handle,"test caption","test title",messagebox_warning))
            messagebox(create_window_handle,"OK","",messagebox_tips);
    } else
        messagebox(create_window_handle,"Window test ERROR!","test WARNING!",messagebox_warning);
}
